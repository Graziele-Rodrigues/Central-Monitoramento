## central/components/mqtt_app/Kconfig.projbuild
```kconfig
menu "MQTT Configuration"

    config BROKER_URL
        string "Broker URL"
        default "mqtt://broker.hivemq.com"
        help
            URL of the broker to connect to
          
endmenu
```
